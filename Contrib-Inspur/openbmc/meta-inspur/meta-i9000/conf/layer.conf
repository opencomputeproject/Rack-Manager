## Contrib-Inspur/openbmc/meta-inspur/meta-i9000/conf/layer.conf
```bitbake
# We have a conf and classes directory, add to BBPATH
BBPATH .= ":${LAYERDIR}"

# We have recipes-* directories, add to BBFILES
BBFILES += "${LAYERDIR}/recipes-*/*/*.bb \
            ${LAYERDIR}/recipes-*/*/*.bbappend"

BBFILE_COLLECTIONS += "i9000-layer"
BBFILE_PATTERN_i9000-layer = "^${LAYERDIR}/"
BBFILE_PRIORITY_i9000-layer = "6"

LAYERSERIES_COMPAT_i9000-layer = "warrior zeus"

INSPURBASE = '${@os.path.normpath("${LAYERDIR}/")}'
```

## Contrib-Inspur/openbmc/meta-inspur/meta-i9000/conf/machine/i9000.conf
```bitbake
KMACHINE = "aspeed"
KERNEL_DEVICETREE = "${KMACHINE}-bmc-inspur-${MACHINE}.dtb"

require conf/machine/include/ast2400.inc
require conf/machine/include/obmc-bsp-common.inc
require inspur.inc

UBOOT_MACHINE_i9000 = "ast_g4_phy_config"
UBOOT_ENTRYPOINT = "0x40008000"
UBOOT_LOADADDRESS = "0x40008000"

FLASH_SIZE = "32768"

#VIRTUAL-RUNTIME_skeleton_workbook = "${MACHINE}-config"
```

## Contrib-Microsoft/Olympus-rackmanager-build/yoctoBuilds/conf/bblayers.conf
```bitbake
# LAYER_CONF_VERSION is increased each time build/conf/bblayers.conf
# changes incompatibly
LCONF_VERSION = "6"

BBPATH = "${TOPDIR}"
BBFILES ?= ""

BBLAYERS ?= " \
  ${TOPDIR}/../yocto/meta \
  ${TOPDIR}/../yocto/meta-yocto \
  ${TOPDIR}/../yocto/meta-yocto-bsp \
  ${TOPDIR}/../yocto/meta-openembedded/meta-oe \
  ${TOPDIR}/../yocto/meta-openembedded/meta-python \
  ${TOPDIR}/../yocto/meta-openembedded/meta-networking \
  ${TOPDIR}/../yocto/meta-cloud-services/meta-openstack \
  ${TOPDIR}/../yocto/meta-ti \
  ${TOPDIR}/../yocto/meta-rackmanager \
  "
BBLAYERS_NON_REMOVABLE ?= " \
  ${TOPDIR}/../yocto/meta \
  ${TOPDIR}/../yocto/meta-yocto \
  "
```

## Contrib-Microsoft/Olympus_meta_rack_manager/conf/layer.conf
```bitbake
# We have a conf and classes directory, add to BBPATH
BBPATH .= ":${LAYERDIR}"

# We have recipes-* directories, add to BBFILES
BBFILES += "${LAYERDIR}/recipes-*/*/*.bb \
	${LAYERDIR}/recipes-*/*/*.bbappend"

BBFILE_COLLECTIONS += "meta-rackmanager"
BBFILE_PATTERN_meta-rackmanager = "^${LAYERDIR}/"
BBFILE_PRIORITY_meta-rackmanager = "6"
```

## Contrib-Microsoft/Olympus_meta_rack_manager/conf/machine/ocs-am437x.conf
```bitbake
#@TYPE: Machine
#@NAME: OCS AM437x 
#@DESCRIPTION: Machine configuration for the Microsoft OCS board based on TI AM437x EVM

require conf/machine/include/ti43x.inc

IMAGE_FSTYPES += "tar.gz"
SERIAL_CONSOLES ?= "115200;ttyO1;-i 115200;ttyO2;-i"

# Remove all Xserver stuff (refer to include ti43x.inc)
XSERVER = ""
MACHINE_GUI_CLASS = ""
PREFERRED_PROVIDER_virtual/xserver = ""

# Specify specific kernel and uboot version 
PREFERRED_VERSION_linux-ti-staging = "4.1%"

# Remove unnecessary machine features (refer to include ti43x.inc)
MACHINE_FEATURES_remove = "usbgadget usbhost alsa"
```
